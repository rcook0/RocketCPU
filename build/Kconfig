## build/defconfig
```kconfig
# YourCorp SoC defconfig fragment

CONFIG_OF=y
CONFIG_OF_EARLY_FLATTREE=y

# SPAD64 scratchpad driver
CONFIG_YOURCORP_SPAD64=m

# Interconnect manager driver
CONFIG_YOURCORP_INTERCONNECT=m

# CPUfreq core + our driver
CONFIG_CPU_FREQ=y
CONFIG_CPU_FREQ_DEFAULT_GOV_SCHEDUTIL=y
CONFIG_CPU_FREQ_GOV_SCHEDUTIL=y
CONFIG_CPU_FREQ_GOV_ONDEMAND=y
CONFIG_CPU_FREQ_GOV_CONSERVATIVE=y
CONFIG_YOURCORP_CPUFREQ=m
```
